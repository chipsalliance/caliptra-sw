## hw/fpga/petalinux_project/project-spec/configs/configs/Kconfig.main
```kconfig
# Copyright (C) 2021-2022, Xilinx, Inc.  All rights reserved.
# Copyright (C) 2022-2023, Advanced Micro Devices, Inc.  All rights reserved.
#
# SPDX-License-Identifier: MIT
#

choice
	prompt "Subsystem Architecture (NO EDIT!)"
	default SUBSYSTEM_ARCH_ARM
	help
	  This option is to control the processor targeted by PetaLinux.
	  WARNING: Do not edit this option.

config SUBSYSTEM_ARCH_AARCH64
	bool "aarch64"
	help
	  Choose this option to specify AARCH64 as the SUBSYSTEM architecture

config SUBSYSTEM_ARCH_ARM
	bool "arm"
	help
	  Choose this option to specify ARM as the SUBSYSTEM architecture

config SUBSYSTEM_ARCH_MICROBLAZE
	bool "microblaze"
	help
	  Choose this option to specify MicroBlaze as the SUBSYSTEM architecture
endchoice

config SUBSYSTEM_ENDIAN_LITTLE
	bool
	default y

if SUBSYSTEM_DISTRO_PETALINUX

source /home/clundin/caliptra-sw/hw/fpga/petalinux_project/project-spec/configs/configs/Kconfig.linuxcompselection

source /home/clundin/caliptra-sw/hw/fpga/petalinux_project/project-spec/configs/configs/Kconfig.autoconfigsettings

endif

source /home/clundin/caliptra-sw/hw/fpga/petalinux_project/project-spec/configs/configs/Kconfig.syshw

source /home/clundin/caliptra-sw/hw/fpga/petalinux_project/project-spec/configs/configs/Kconfig.dtgsettings

source /home/clundin/caliptra-sw/hw/fpga/petalinux_project/project-spec/configs/configs/Kconfig.bootcompconfigurations

if SUBSYSTEM_DISTRO_PETALINUX

source /home/clundin/caliptra-sw/hw/fpga/petalinux_project/project-spec/configs/configs/Kconfig.imagepkgconfigurations

endif

source /home/clundin/caliptra-sw/hw/fpga/petalinux_project/project-spec/configs/configs/Kconfig.yoctobuildsettings
```

## hw/fpga/petalinux_project/project-spec/configs/configs/Kconfig.yoctobuildsettings
```kconfig
# Copyright (C) 2023, Advanced Micro Devices, Inc.  All rights reserved.
#
# SPDX-License-Identifier: MIT
#

if SUBSYSTEM_DISTRO_PETALINUX
menu "Firmware Version Configuration"
config SUBSYSTEM_HOSTNAME
	string "Host name"
	default "petalinux"
	help
	 The host name of your SUBSYSTEM, set at startup.

config SUBSYSTEM_PRODUCT
	string "Product name"
	default ""
	help
	  This is an string inserted into /etc/product during the build.

config SUBSYSTEM_FW_VERSION
	string "Firmware Version"
	default "1.00"
	help
	  This is an arbitrary string value that is inserted into
	  /etc/version during the build.
endmenu
endif

if !SUBSYSTEM_DISTRO_PETALINUX
source /home/clundin/caliptra-sw/hw/fpga/petalinux_project/project-spec/configs/configs/Kconfig.yoctomachinesettings
endif

if SUBSYSTEM_DISTRO_PETALINUX
menu "Yocto Settings"

source /home/clundin/caliptra-sw/hw/fpga/petalinux_project/project-spec/configs/configs/Kconfig.yoctomachinesettings

if SUBSYSTEM_SDT_FLOW
config MC_PLNX_IMAGES_LOCATION
        string "PetaLinux Multiconfig Deploy Directory"
        help
          Specify the PetaLinux multiconfig deploy directory to place the generated build artifacts.

endif

menu "TMPDIR Location"
config TMP_DIR_LOCATION
	string "TMPDIR Location"
	default "${PROOT}/build/tmp"
	help
	  Relative path can be used with reference to ${PROOT}
	  Note: ${PROOT} is a PetaLinux variable, Using bitbake variable such as
	        ${TOPDIR} will not be functional.
endmenu

menu "Devtool Workspace Location"
config DEVTOOL_WORKSPACE_LOCATION
	string "Devtool Workspace Location"
	default "${PROOT}/components/yocto/workspace"
	help
	  Specify the devtool workspace directory, This will setup a workspace layer
	  in an alternative specified absolute or releative path using layerpath option.
	  Relative path can be used with reference to ${PROOT}
	  Note: ${PROOT} is a PetaLinux variable, Using bitbake variable such as
		${TOPDIR} will not be functional.
endmenu

config PLNX_IMAGES_LOCATION
	string "PetaLinux Deploy Directory"
	help
	  Specify the PetaLinux deploy directory to place the generated build artifacts.

menu "Parallel thread execution"
config YOCTO_BB_NUMBER_THREADS
	string "Set number of bb threads (BB_NUMBER_THREADS)"
	help
	  Sets the number of tasks BitBake should run in parallel at any one time.
	  By default BitBake calculates the number of tasks is equal to the
	  number of cores on the build system.

config YOCTO_BB_NUMBER_PARSE_THREADS
	string "Set number of bb parse threads (BB_NUMBER_PARSE_THREADS)"
	help
	  Sets the number of threads BitBake uses when parsing.
	  By default BitBake calculates the number of threads is equal
	  to the number of cores on the build system.

config YOCTO_PARALLEL_MAKE
	string "Set number of parallel make -j (PARALLEL_MAKE)"
	help
	  Specify parallel compilation on the local build host
	  during the do_compile task.
	  By default BitBake calculates the number of cores on the build system.

endmenu

menu "Add pre-mirror url "
config PRE_MIRROR_URL
        string "pre-mirror url path"
        help
	pre-mirrors is used by bitbake to fetch sources from specified location first.
	If sources are not available in pre-mirrors, bitbake then fetches from SRC_URI in the recipes.

        path can be ftp, https or local directory.examples are
        "file::///path/to/your/downloads/"
        "https://example.com/your/downloadsmirrors/"
        "ftp://example.com/your/downloadsmirrors/"
endmenu

menu "Local sstate feeds settings"
config YOCTO_LOCAL_SSTATE_FEEDS_URL
	string "local sstate feeds url"
	default ""
	help
	 Provide NFS/local sstate feed path.
	 The sstate cache will be pulled from these path and used to build the components.
	 E.g: /some/local/dir/sstate/
endmenu

config YOCTO_NETWORK_SSTATE_FEEDS
	bool "Enable Network sstate feeds"
	default y
	help
	 The sstate feeds which are hosted on webserver has to be provided.
	 The sstate cache will be pulled from these servers and rootfs was generated.

menu "Network sstate feeds URL"
	depends on YOCTO_NETWORK_SSTATE_FEEDS
config YOCTO_NETWORK_SSTATE_FEEDS_URL
	string "network sstate feeds url"
	default ""
	help
	 Provide Network sstate feed URI.
	 The sstate cache will be pulled from these servers and used to build the components.
	 E.g: https://someserver.tld/share/sstate/
endmenu

config YOCTO_BB_NO_NETWORK
	bool "Enable BB NO NETWORK"
	default n
	help
	 Enabling this option restricts bitbake to go to internet for fetching.

config YOCTO_BUILDTOOLS_EXTENDED
	bool "Enable Buildtools Extended"
	default n
	help
	 Enabling this option to use the gcc and other libraries from $PETALINUX/components/yocto/buildtools_extended/
	 Use this option on a machine that does not meet the minimal gcc, Git, tar, and Python requirements.

menu "User Layers"
config USER_LAYER_0
	string "user layer 0"
	help
	  You can specify relative path or absolute path of layer.
	  To add layer at <project-root>/project-spec/meta-security
	  Enter: ${PROOT}/project-spec/meta-security
	  Note: ${PROOT} is a PetaLinux variable, Using bitbake variable such as
	        ${TOPDIR} will not be functional.

config USER_LAYER_1
	string "user layer 1"
	depends on USER_LAYER_0 != ""
	help
	  You can specify relative path or absolute path of layer.
	  To add layer at <project-root>/project-spec/meta-security
	  Enter: ${PROOT}/project-spec/meta-security
	  Note: ${PROOT} is a PetaLinux variable, Using bitbake variable such as
	        ${TOPDIR} will not be functional.

config USER_LAYER_2
	string "user layer 2"
	depends on USER_LAYER_1 != ""
	help
	  You can specify relative path or absolute path of layer.
	  To add layer at <project-root>/project-spec/meta-security
	  Enter: ${PROOT}/project-spec/meta-security
	  Note: ${PROOT} is a PetaLinux variable, Using bitbake variable such as
	        ${TOPDIR} will not be functional.

config USER_LAYER_3
	string "user layer 3"
	depends on USER_LAYER_2 != ""
	help
	  You can specify relative path or absolute path of layer.
	  To add layer at <project-root>/project-spec/meta-security
	  Enter: ${PROOT}/project-spec/meta-security
	  Note: ${PROOT} is a PetaLinux variable, Using bitbake variable such as
	        ${TOPDIR} will not be functional.

config USER_LAYER_4
	string "user layer 4"
	depends on USER_LAYER_3 != ""
	help
	  You can specify relative path or absolute path of layer.
	  To add layer at <project-root>/project-spec/meta-security
	  Enter: ${PROOT}/project-spec/meta-security
	  Note: ${PROOT} is a PetaLinux variable, Using bitbake variable such as
	        ${TOPDIR} will not be functional.

config USER_LAYER_5
	string "user layer 5"
	depends on USER_LAYER_4 != ""
	help
	  You can specify relative path or absolute path of layer.
	  To add layer at <project-root>/project-spec/meta-security
	  Enter: ${PROOT}/project-spec/meta-security
	  Note: ${PROOT} is a PetaLinux variable, Using bitbake variable such as
	        ${TOPDIR} will not be functional.

config USER_LAYER_6
	string "user layer 6"
	depends on USER_LAYER_5 != ""
	help
	  You can specify relative path or absolute path of layer.
	  To add layer at <project-root>/project-spec/meta-security
	  Enter: ${PROOT}/project-spec/meta-security
	  Note: ${PROOT} is a PetaLinux variable, Using bitbake variable such as
	        ${TOPDIR} will not be functional.

config USER_LAYER_7
	string "user layer 7"
	depends on USER_LAYER_6 != ""
	help
	  You can specify relative path or absolute path of layer.
	  To add layer at <project-root>/project-spec/meta-security
	  Enter: ${PROOT}/project-spec/meta-security
	  Note: ${PROOT} is a PetaLinux variable, Using bitbake variable such as
	        ${TOPDIR} will not be functional.

config USER_LAYER_8
	string "user layer 8"
	depends on USER_LAYER_7 != ""
	help
	  You can specify relative path or absolute path of layer.
	  To add layer at <project-root>/project-spec/meta-security
	  Enter: ${PROOT}/project-spec/meta-security
	  Note: ${PROOT} is a PetaLinux variable, Using bitbake variable such as
	        ${TOPDIR} will not be functional.

config USER_LAYER_9
	string "user layer 9"
	depends on USER_LAYER_8 != ""
	help
	  You can specify relative path or absolute path of layer.
	  To add layer at <project-root>/project-spec/meta-security
	  Enter: ${PROOT}/project-spec/meta-security
	  Note: ${PROOT} is a PetaLinux variable, Using bitbake variable such as
	        ${TOPDIR} will not be functional.

endmenu
endmenu
endif
```

## hw/fpga/petalinux_project/project-spec/configs/configs/Kconfig.yoctomachinesettings
```kconfig
# Copyright (C) 2023, Advanced Micro Devices, Inc.  All rights reserved.
#
# SPDX-License-Identifier: MIT
#
#
config YOCTO_MACHINE_NAME
       string "Yocto Machine Name"
       default "versal-net-generic" if SUBSYSTEM_VARIANT_VERSALNET
       default "versal-generic" if SYSTEM_VERSAL
       default "zynqmp-generic" if SYSTEM_ZYNQMP
       default "zynq-generic" if SUBSYSTEM_ARCH_ARM
       default "microblaze-generic" if SUBSYSTEM_ARCH_MICROBLAZE
       help
         You can specify MACHINE_NAME using this variable.
	 Auto append the deviceId to Machine Name if this matches with INCLUDE_MACHINE_NAME

config YOCTO_INCLUDE_MACHINE_NAME
	string "Yocto Include Machine name"
	default "ac701-microblazeel" if YOCTO_MACHINE_NAME = "xilinx-ac701"
	default "kc705-microblazeel" if YOCTO_MACHINE_NAME = "xilinx-kc705"
	default "kcu105-microblazeel" if YOCTO_MACHINE_NAME = "xilinx-kcu105"
	default "vcu118-microblazeel" if YOCTO_MACHINE_NAME = "xilinx-vcu118"
	default "kcu105-tmr-microblazeel" if YOCTO_MACHINE_NAME = "xilinx-sp701"
	default "zc702-zynq7" if YOCTO_MACHINE_NAME = "xilinx-zc702"
	default "zc706-zynq7" if YOCTO_MACHINE_NAME = "xilinx-zc706"
	default "zedboard-zynq7" if YOCTO_MACHINE_NAME = "avnet-digilent-zedboard"
	default "zc1751-zynqmp" if YOCTO_MACHINE_NAME = "xilinx-zc1751-dc1"
	default "zcu102-zynqmp" if YOCTO_MACHINE_NAME = "xilinx-zcu102"
	default "zcu104-zynqmp" if YOCTO_MACHINE_NAME = "xilinx-zcu104"
	default "zcu106-zynqmp" if YOCTO_MACHINE_NAME = "xilinx-zcu106"
	default "zcu111-zynqmp" if YOCTO_MACHINE_NAME = "xilinx-zcu111"
	default "zcu208-zynqmp" if YOCTO_MACHINE_NAME = "xilinx-zcu208"
	default "zcu216-zynqmp" if YOCTO_MACHINE_NAME = "xilinx-zcu216"
	default "zcu670-zynqmp" if YOCTO_MACHINE_NAME = "xilinx-zcu670"
	default "k26-sm" if YOCTO_MACHINE_NAME = "xilinx-k26-som"
	default "k24-sm" if YOCTO_MACHINE_NAME = "xilinx-k24-som"
	default "k26-smk-kr" if YOCTO_MACHINE_NAME = "xilinx-k26-kr"
	default "k26-smk-kv" if YOCTO_MACHINE_NAME = "xilinx-k26-kv"
	default "k24-smk-kd" if YOCTO_MACHINE_NAME = "xilinx-k24-kd"
	default "vck-sc-zynqmp" if YOCTO_MACHINE_NAME = "xilinx-vck190-sc"
	default "eval-brd-sc-zynqmp" if YOCTO_MACHINE_NAME = "eval-brd-sc"
	default "vck190-versal" if YOCTO_MACHINE_NAME = "xilinx-vck190"
	default "vc-p-a2197-00-versal" if YOCTO_MACHINE_NAME = "xilinx-vc-p-a2197-00"
	default "vck5000-versal" if YOCTO_MACHINE_NAME = "xilinx-vck5000"
	default "vek280-versal" if YOCTO_MACHINE_NAME = "xilinx-vek280"
	default "vhk158-versal" if YOCTO_MACHINE_NAME = "xilinx-vhk158"
	default "vmk180-versal" if YOCTO_MACHINE_NAME = "xilinx-vmk180"
	default "vpk120-versal" if YOCTO_MACHINE_NAME = "xilinx-vpk120"
	default "vpk180-versal" if YOCTO_MACHINE_NAME = "xilinx-vpk180"
	help
	  Specify MACHINE_NAME which will need to be include into the YOCTO_MACHINE file

config YOCTO_ADD_OVERRIDES
	string "Yocto Additional Overrides"
	default ""
	help
	  Specify additional overrides to the generated machine conf file
	  Specify multiple overrides with ':' separator

if SUBSYSTEM_SDT_FLOW



endif
```

## hw/fpga/petalinux_project/project-spec/configs/rootfsconfigs/Kconfig.user
```kconfig
menu "user packages " 
config gpio-demo  
	 bool "gpio-demo"
	 help
	
config io-module  
	 bool "io-module"
	 help
	
config peekpoke  
	 bool "peekpoke"
	 help
	
config rom-backdoor  
	 bool "rom-backdoor"
	 help
	
endmenu
```

## libcaliptra/zephyr/Kconfig
```kconfig
# Licensed under the Apache-2.0 license

menuconfig LIBCALIPTRA
	bool "Enable Libcaliptra"
	help
	  This is a library to help interface with Caliptra.

if LIBCALIPTRA

module = LIBCALIPTRA
module-str = libcaliptra
source "subsys/logging/Kconfig.template.log_config"

endif # LIBCALIPTRA
```
