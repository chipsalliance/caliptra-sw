## hw/fpga/petalinux_project/project-spec/configs/configs/Kconfig.dtgsettings
```kconfig
# Copyright (C) 2023, Advanced Micro Devices, Inc.  All rights reserved.
#
# SPDX-License-Identifier: MIT
#

menu "DTG Settings"
config SUBSYSTEM_MACHINE_NAME
        string "MACHINE_NAME"
        default "template"
        help
	 Keep empty or specify auto/AUTO it will point to DTG machine name based on the
	 yocto machine name specified in config.
         This is machine name or board name. Ex: zcu102, zc702
         This is used to create board related nodes.
         Change this only when you also change the corresponding hardware design.
         Change of hardware design or Machine_name between same architecture is allowed

config SUBSYSTEM_DT_XSCT_WORKSPACE
	string "Device-tree workspace"
	help
	  Provide the location to use as Device-tree XSCT workspace location.

config SUBSYSTEM_DTB_PADDING_SIZE
	hex "DTB padding size"
	default 0x1000
	help
	  Set this value for DTB padding size

if SUBSYSTEM_DISTRO_PETALINUX
if SUBSYSTEM_AUTOCONFIG_DEVICE__TREE
config SUBSYSTEM_EXTRA_DT_FILES
	string "Extra dts/dtsi files"
	default ""
	help
	  Provide the extra dt files path separated with space.
	  This config should be set with dts/dtsi absolute/full path.
	  Provided dts/dtsi will be build as part of device-tree and deploy into /boot/devicetree.
	  NOTE: All dtsi files should be added to this config which are included in dts file.
	  Example: /extra-dt-path/can.dtsi /extra-dt-path/test.dtsi

menu "Kernel Bootargs"
config SUBSYSTEM_BOOTARGS_AUTO
	bool "generate boot args automatically"
	default y
	depends on !SUBSYSTEM_SERIAL_MANUAL_SELECT
	help
	  Generates the default bootargs.

config SUBSYSTEM_USER_CMDLINE
	string "user set kernel bootargs"
	default ""
	depends on !SUBSYSTEM_BOOTARGS_AUTO
	help
	  Specify any commandline arguments you wish to pass to the kernel
	  at boot.

config SUBSYSTEM_BOOTARGS_EARLYPRINTK
	bool "enable kernel earlyprintk"
	default y
	depends on SUBSYSTEM_BOOTARGS_AUTO
	help
	  Select this option to enable kernel earlyprintk.

config SUBSYSTEM_BOOTARGS_GENERATED
	string "Auto generated bootargs (NO EDIT!)"
	default ""
	depends on SUBSYSTEM_BOOTARGS_AUTO
	help
	  system auto generated bootargs.
	  WARNING: Do not edit, your changes will be lost.
	  Disable SUBSYSTEM_BOOTARGS_AUTO to edit bootargs through SUBSYSTEM_USER_CMDLINE option

config SUBSYSTEM_EXTRA_BOOTARGS
	string "Add extra boot args"
	default ""
	depends on SUBSYSTEM_BOOTARGS_AUTO
	help
	  Select this option to append extra bootargs

endmenu
endif
config SUBSYSTEM_DEVICETREE_COMPILER_FLAGS
	string "Devicetree compiler flags"
	default ""
	help
	  Mention device-tree compiler flags.
	  These will be passed to dtc while compiling device-trees.
	  Ex: -@

if !SUBSYSTEM_ARCH_MICROBLAZE
config SUBSYSTEM_DTB_OVERLAY
       bool "Devicetree overlay"
       default n
       help
         Select this option to separate pl from base dtb
         and build the pl.dtsi to generate pl.dtbo.

config SUBSYSTEM_REMOVE_PL_DTB
       bool "Remove PL from devicetree"
       default n
       help
	Remove PL nodes if user doesn't depend on the PL IPs and
	if any PL IP in DTG generates an error then user can
	simply enable this flag and DTG won't generate any PL nodes.

endif

if !SUBSYSTEM_ARCH_MICROBLAZE && !SUBSYSTEM_ARCH_ARM && !SUBSYSTEM_SDT_FLOW
config SUBSYSTEM_ENABLE_OPENAMP_DTSI
    bool "Enable openamp dtsi"
    default n
    help
     Enable this config to automatically add OpenAmp device tree nodes (openamp.dtsi)
     to the final system.dtb

endif

if !SUBSYSTEM_ARCH_MICROBLAZE && !SUBSYSTEM_ARCH_ARM
config SUBSYSTEM_ENABLE_XEN_HW_DTSI
	bool "Enable xen hardware dtsi"
	default n
	help
	 Enable this config to automatically add Xen hardware related
	 device tree nodes (xen.dtsi) to the final system.dtb

config SUBSYSTEM_ENABLE_XEN_QEMU_DTSI
	bool "Enable xen QEMU dtsi"
	default n
	help
	 Enable this config to automatically add Xen qemu related
	 device tree nodes (xen-qemu.dtsi) to the final system.dtb

endif

if !SUBSYSTEM_SDT_FLOW
config SUBSYSTEM_ENABLE_NO_ALIAS
	bool "Enable board specific aliases"
	default n
	help
	 Enable board specific aliases defined in DT machine file for different evluation boards.

config SUBSYSTEM_ENABLE_DTG_ALIAS
	bool "Enable aliases generated by DTG"
	default n
	help
	 Enable this option to get DTG generated aliases.
	 NOTE: This will not effect if ENABLE_NO_ALIAS selected So final DT will have board aliases.

config SUBSYSTEM_ENABLE_NO_LABELS
	bool "Disable labels For Partial DT files"
	default n
	depends on SUBSYSTEM_FPGA_MANAGER
	help
	 Enable this option to not generated the labels in partial dtbo files.
	 There will not be any Changes in base dtb or PL dtb or dtbo files.
	 User should take care of the nodes if any build failures.

config SUBSYSTEM_ENABLE_DT_VERBOSE
	bool "Enable dt verbose"
	default n
	help
	 Enable this option to get additional logs for device-tree.
	 These debug prints can be seen in log.do_configure which will be saved in device-tree workspace directory.

if !SUBSYSTEM_ENABLE_NO_ALIAS
config SUBSYSTEM_ADD_EEPROM_ALIAS
	bool "Enable eeprom alias"
	default n
	help
	 Enable this option to add eeprom in aliases node
	 E.g: nvmem0 = &eeprom

config SUBSYSTEM_ADD_RTC_ALIAS
	bool "Enable rtc alias"
	default n
	help
	 Enable this option to add rtc in alias node
	 E.g: rtc0 = &rtc
endif
endif
endif
endmenu

if !SUBSYSTEM_ARCH_MICROBLAZE
menu "FPGA Manager"
config SUBSYSTEM_FPGA_MANAGER
        bool "Fpga Manager"
        help
	 Select this option to provides an interface to the Linux for configuring the programmable logic(PL).

if SUBSYSTEM_FPGA_MANAGER && SUBSYSTEM_SDT_FLOW
choice
	prompt "PL Device-Tree Overlay Type"

config SUBSYSTEM_PL_DT_OVERLAY_FULL
	bool "full"

config SUBSYSTEM_PL_DT_OVERLAY_DFX
	bool "dfx"

endchoice
endif
endmenu
endif
```

## hw/fpga/petalinux_project/project-spec/configs/configs/Kconfig.imagepkgconfigurations
```kconfig
# Copyright (C) 2023, Advanced Micro Devices, Inc.  All rights reserved.
#
# SPDX-License-Identifier: MIT
#

menu "Image Packaging Configuration"
choice
prompt "Root filesystem type"
default SUBSYSTEM_ROOTFS_INITRAMFS

config SUBSYSTEM_ROOTFS_INITRAMFS
	bool "INITRAMFS"
	help
	  Choose this option to configure your PetaLinux build to use
	  the kernel INITRAMFS mechanism for the root filesystem.

	  The root filesystem will be writeable, but not persistent,
	  meaning that any changes are lost upon reboot.

config SUBSYSTEM_ROOTFS_INITRD
	bool "INITRD"
	help
	  Choose this opion to configure your PetaLinux build to use
	  kernel INITRD mechinsm for the root filesystem.

config SUBSYSTEM_ROOTFS_UBIFS
	bool "UBI/UBIFS"
	help
	  Choose this option to configure your PetaLinux build for the
	  root filesystem to be mounted on a UBI/UBIFS flash partition.

	  You must also ensure that your Flash Partition Table
          contains a partition named "ubi" and is of a suitable size.

config SUBSYSTEM_ROOTFS_NFS
	bool "NFS"
	help
	  Choose this setting to configure your PetaLinux build for NFS Root.

	  Your workstation must be properly configured for NFS, and the
	  NFS root directory (see below) must be exported properly.

config SUBSYSTEM_ROOTFS_EXT4
	bool "EXT4 (SD/eMMC/SATA/USB)"
	help
	  Choose this setting to configure your PetaLinux build for EXT4 Root.

          device examples:
          eMMC or SD root=/dev/mmcblkYpX
          SATA or USB root=/dev/sdX

config SUBSYSTEM_ROOTFS_OTHER
	bool "other"
	help
	  Choose this setting to configure your PetaLinux build for other root.

	  You will need to manually generate the Root FS image.

endchoice

config SUBSYSTEM_NFSROOT_DIR
	string "Location of NFS root directory"
	depends on SUBSYSTEM_ROOTFS_NFS
	default "/tftpboot/nfsroot"

config SUBSYSTEM_NFSSERVER_IP
	string "NFS Server IP address"
	default "AUTO"
	depends on SUBSYSTEM_ROOTFS_NFS
	help
	 The IP address of your NFS server in the main network interface.

config SUBSYSTEM_SDROOT_DEV
	string "Device node of SD device"
	depends on SUBSYSTEM_ROOTFS_EXT4
	default "/dev/mmcblk0p2"

config SUBSYSTEM_INITRD_RAMDISK_LOADADDR
	hex "RAMDISK loadaddr"
	default "0x0"
	depends on SUBSYSTEM_ROOTFS_INITRD
	help
	  RAMDISK Load address if INITRD is selected as rootfs type

config SUBSYSTEM_INITRAMFS_IMAGE_NAME
	string "INITRAMFS/INITRD Image name"
	default "petalinux-image-minimal"
	depends on SUBSYSTEM_ROOTFS_INITRD || SUBSYSTEM_ROOTFS_INITRAMFS
	help
	  Specifies the PROVIDES name of an image recipe that is used to
	  build an initial RAM filesystem (initramfs/initrd) image

config SUBSYSTEM_UBI_MKUBIFS_ARGS
	string "mkfs.ubifs args"
	default ""
	depends on SUBSYSTEM_ROOTFS_UBIFS
	help
	  Specify the arguments which needs to be used in mkfs.ubifs for creation of ubifs filesystem.
	  Ex: -m 2048 -e 129024 -c 2047
	  -m 2048  : is the minimum I/O unit here its 2KB.
	  -e 129024: logical eraseblock size of the UBI volume.
	  -c 2047  : specifies maximum file-system size in logical eraseblocks.
	  NOTE: make sure to add "ubifs" into "SUBSYSTEM_RFS_FORMATS" to take these values into consider.

config SUBSYSTEM_UBI_UBINIZE_ARGS
	string "ubinize args"
	default ""
	depends on SUBSYSTEM_ROOTFS_UBIFS
	help
	  Specify the arguments which needs to be used in ubinize for creation of ubifs filesystem.
	  Ex: -m 2048 -p 128KiB -s 512
	  -m 2048  : is the minimum I/O unit here its 2KB.
	  -p 128KiB: tells ubinize that physical eraseblock size of the flash chip the UBI image is created for is 128KiB
	  -s 512: tells ubinize that the flash supports sub-pages and sub-page size is 512 bytes
	  NOTE: make sure to add "ubifs" into "SUBSYSTEM_RFS_FORMATS" to take these values into consider.

config SUBSYSTEM_UBI_PART_NAME
	string "ubi part name"
	default "ubifs"
	depends on SUBSYSTEM_ROOTFS_UBIFS
	help
	  Specify the ubifs part name to be added into bootargs.

config SUBSYSTEM_UIMAGE_NAME
	string "name for bootable kernel image"
	default "image.ub"
	help
	  Specify the name of uboot bootable kernel image

config SUBSYSTEM_RFS_FORMATS
	string "Root filesystem formats"
	default "cpio cpio.gz cpio.gz.u-boot ext4 tar.gz" if SUBSYSTEM_ARCH_AARCH64
	default "cpio cpio.gz cpio.gz.u-boot ext4 tar.gz" if SUBSYSTEM_ARCH_ARM
	default "cpio cpio.gz cpio.gz.u-boot tar.gz" if SUBSYSTEM_ARCH_MICROBLAZE
	help
	  Specifies the formats the build system uses during the build
	  when creating the root filesystem.
	  Supported image formats:
	  tar.gz cpio cpio.gz.u-boot cpio.gz ext4 ext3 ext3.bz2 tar.bz2 cpio.bz2 ext4.gz

config SUBSYSTEM_COPY_TO_TFTPBOOT
	bool "Copy final images to tftpboot"
	help
	  Set this if you would like the final build image to be automatically
	  copied to your TFTP server directory.

config SUBSYSTEM_TFTPBOOT_DIR
	string "tftpboot directory"
	depends on SUBSYSTEM_COPY_TO_TFTPBOOT
	default "/tftpboot"
	help
	  The directory that your TFTP server serves its files from.

if SYSTEM_VERSAL
config SUBSYSTEM_PDI_FILENAME
	string "PDI File name"
	default ""
	help
	  Specify the PDI file name If design file has a multiple .pdi files.

endif
endmenu
```
